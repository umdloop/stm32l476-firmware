VERSION ""

NS_ :

BS_:

BU_:

BO_ 128 SERVO_PCB_C: 8 Vector__XXX
	SG_ cmd M : 0|8@1+ (1,0) [0|0] "" Vector__XXX
	SG_ pcb_heartbeat_delay m16M : 8|8@1+ (1,0) [0|255] "sec" Vector__XXX
	SG_ led_status m17M : 8|1@1+ (1,0) [0|1] "bool" Vector__XXX
	SG_ motor_position_target_0 m32M : 8|16@1- (1,0) [-32768|32767] "deg" Vector__XXX
	SG_ motor_position_target_1 m33M : 8|16@1- (1,0) [-32768|32767] "deg" Vector__XXX
	SG_ motor_position_target_2 m34M : 8|16@1- (1,0) [-32768|32767] "deg" Vector__XXX
	SG_ motor_position_target_3 m35M : 8|16@1- (1,0) [-32768|32767] "deg" Vector__XXX
	SG_ motor_position_target_4 m36M : 8|16@1- (1,0) [-32768|32767] "deg" Vector__XXX
	SG_ motor_position_target_5 m37M : 8|16@1- (1,0) [-32768|32767] "deg" Vector__XXX
	SG_ motor_velocity_target_0 m48M : 8|16@1- (1,0) [-32768|32767] "deg/s" Vector__XXX
	SG_ motor_velocity_target_1 m49M : 8|16@1- (1,0) [-32768|32767] "deg/s" Vector__XXX
	SG_ motor_velocity_target_2 m50M : 8|16@1- (1,0) [-32768|32767] "deg/s" Vector__XXX
	SG_ motor_velocity_target_3 m51M : 8|16@1- (1,0) [-32768|32767] "deg/s" Vector__XXX
	SG_ motor_velocity_target_4 m52M : 8|16@1- (1,0) [-32768|32767] "deg/s" Vector__XXX
	SG_ motor_velocity_target_5 m53M : 8|16@1- (1,0) [-32768|32767] "deg/s" Vector__XXX
	SG_ motor_state_req_event_0 m64M : 8|1@1- (1,0) [0|1] "bool" Vector__XXX
	SG_ motor_state_req_event_1 m65M : 8|1@1- (1,0) [0|1] "bool" Vector__XXX
	SG_ motor_state_req_event_2 m66M : 8|1@1- (1,0) [0|1] "bool" Vector__XXX
	SG_ motor_state_req_event_3 m67M : 8|1@1- (1,0) [0|1] "bool" Vector__XXX
	SG_ motor_state_req_event_4 m68M : 8|1@1- (1,0) [0|1] "bool" Vector__XXX
	SG_ motor_state_req_event_5 m69M : 8|1@1- (1,0) [0|1] "bool" Vector__XXX
	SG_ motor_status_req_event_0 m80M : 8|1@1- (1,0) [0|1] "bool" Vector__XXX
	SG_ motor_status_req_event_1 m81M : 8|1@1- (1,0) [0|1] "bool" Vector__XXX
	SG_ motor_status_req_event_2 m82M : 8|1@1- (1,0) [0|1] "bool" Vector__XXX
	SG_ motor_status_req_event_3 m83M : 8|1@1- (1,0) [0|1] "bool" Vector__XXX
	SG_ motor_status_req_event_4 m84M : 8|1@1- (1,0) [0|1] "bool" Vector__XXX
	SG_ motor_status_req_event_5 m85M : 8|1@1- (1,0) [0|1] "bool" Vector__XXX
	SG_ maintenance_cmd_0 m96M : 8|8@1+ (1,0) [0|255] "uint8" Vector__XXX
	SG_ maintenance_cmd_1 m97M : 8|8@1+ (1,0) [0|255] "uint8" Vector__XXX
	SG_ maintenance_cmd_2 m98M : 8|8@1+ (1,0) [0|255] "uint8" Vector__XXX
	SG_ maintenance_cmd_3 m99M : 8|8@1+ (1,0) [0|255] "uint8" Vector__XXX
	SG_ maintenance_cmd_4 m100M : 8|8@1+ (1,0) [0|255] "uint8" Vector__XXX
	SG_ maintenance_cmd_5 m101M : 8|8@1+ (1,0) [0|255] "uint8" Vector__XXX
	SG_ servo_spec_req_0 m112M : 8|1@1+ (0,0) [0|1] "bool" Vector__XXX
	SG_ servo_spec_req_1 m113M : 8|1@1+ (0,0) [0|1] "bool" Vector__XXX
	SG_ servo_spec_req_2 m114M : 8|1@1+ (0,0) [0|1] "bool" Vector__XXX
	SG_ servo_spec_req_3 m115M : 8|1@1+ (0,0) [0|1] "bool" Vector__XXX
	SG_ servo_spec_req_4 m116M : 8|1@1+ (0,0) [0|1] "bool" Vector__XXX
	SG_ servo_spec_req_5 m117M : 8|1@1+ (0,0) [0|1] "bool" Vector__XXX

BO_ 129 SERVO_PCB_R: 8 Vector__XXX
	SG_ req M : 0|8@1+ (1,0) [0|0] "" Vector__XXX
	SG_ heartbeat_success m16M : 8|8@1+ (1,0) [0|1] "bool" Vector__XXX
	SG_ motor_position_0 m32M : 8|16@1- (1,0) [-32768|32767] "deg" Vector__XXX
	SG_ motor_position_1 m33M : 8|16@1- (1,0) [-32768|32767] "deg" Vector__XXX
	SG_ motor_position_2 m34M : 8|16@1- (1,0) [-32768|32767] "deg" Vector__XXX
	SG_ motor_position_3 m35M : 8|16@1- (1,0) [-32768|32767] "deg" Vector__XXX
	SG_ motor_position_4 m36M : 8|16@1- (1,0) [-32768|32767] "deg" Vector__XXX
	SG_ motor_position_5 m37M : 8|16@1- (1,0) [-32768|32767] "deg" Vector__XXX
	SG_ motor_velocity_0 m32M : 24|16@1- (1,0) [-32768|32767] "deg/s" Vector__XXX
	SG_ motor_velocity_1 m33M : 24|16@1- (1,0) [-32768|32767] "deg/s" Vector__XXX
	SG_ motor_velocity_2 m34M : 24|16@1- (1,0) [-32768|32767] "deg/s" Vector__XXX
	SG_ motor_velocity_3 m35M : 24|16@1- (1,0) [-32768|32767] "deg/s" Vector__XXX
	SG_ motor_velocity_4 m36M : 24|16@1- (1,0) [-32768|32767] "deg/s" Vector__XXX
	SG_ motor_velocity_5 m37M : 24|16@1- (1,0) [-32768|32767] "deg/s" Vector__XXX
	SG_ motor_position_6 m48M : 8|16@1- (1,0) [-32768|32767] "deg" Vector__XXX
	SG_ motor_position_7 m49M : 8|16@1- (1,0) [-32768|32767] "deg" Vector__XXX
	SG_ motor_position_8 m50M : 8|16@1- (1,0) [-32768|32767] "deg" Vector__XXX
	SG_ motor_position_9 m51M : 8|16@1- (1,0) [-32768|32767] "deg" Vector__XXX
	SG_ motor_position_10 m52M : 8|16@1- (1,0) [-32768|32767] "deg" Vector__XXX
	SG_ motor_position_11 m53M : 8|16@1- (1,0) [-32768|32767] "deg" Vector__XXX
	SG_ motor_velocity_6 m48M : 24|16@1- (1,0) [-32768|32767] "deg/s" Vector__XXX
	SG_ motor_velocity_7 m49M : 24|16@1- (1,0) [-32768|32767] "deg/s" Vector__XXX
	SG_ motor_velocity_8 m50M : 24|16@1- (1,0) [-32768|32767] "deg/s" Vector__XXX
	SG_ motor_velocity_9 m51M : 24|16@1- (1,0) [-32768|32767] "deg/s" Vector__XXX
	SG_ motor_velocity_10 m52M : 24|16@1- (1,0) [-32768|32767] "deg/s" Vector__XXX
	SG_ motor_velocity_11 m53M : 24|16@1- (1,0) [-32768|32767] "deg/s" Vector__XXX
	SG_ motor_position_12 m64M : 8|16@1- (1,0) [-32768|32767] "deg" Vector__XXX
	SG_ motor_position_13 m65M : 8|16@1- (1,0) [-32768|32767] "deg" Vector__XXX
	SG_ motor_position_14 m66M : 8|16@1- (1,0) [-32768|32767] "deg" Vector__XXX
	SG_ motor_position_15 m67M : 8|16@1- (1,0) [-32768|32767] "deg" Vector__XXX
	SG_ motor_position_16 m68M : 8|16@1- (1,0) [-32768|32767] "deg" Vector__XXX
	SG_ motor_position_17 m69M : 8|16@1- (1,0) [-32768|32767] "deg" Vector__XXX
	SG_ motor_velocity_12 m64M : 24|16@1- (1,0) [-32768|32767] "deg/s" Vector__XXX
	SG_ motor_velocity_13 m65M : 24|16@1- (1,0) [-32768|32767] "deg/s" Vector__XXX
	SG_ motor_velocity_14 m66M : 24|16@1- (1,0) [-32768|32767] "deg/s" Vector__XXX
	SG_ motor_velocity_15 m67M : 24|16@1- (1,0) [-32768|32767] "deg/s" Vector__XXX
	SG_ motor_velocity_16 m68M : 24|16@1- (1,0) [-32768|32767] "deg/s" Vector__XXX
	SG_ motor_velocity_17 m69M : 24|16@1- (1,0) [-32768|32767] "deg/s" Vector__XXX
	SG_ led_success m17M : 8|8@1+ (1,0) [0|1] "bool" Vector__XXX
	SG_ motor_status_0 m80M : 8|8@1+ (1,0) [0|255] "" Vector__XXX
	SG_ motor_status_1 m81M : 8|8@1+ (1,0) [0|255] "" Vector__XXX
	SG_ motor_status_2 m82M : 8|8@1+ (1,0) [0|255] "" Vector__XXX
	SG_ motor_status_3 m83M : 8|8@1+ (1,0) [0|255] "" Vector__XXX
	SG_ motor_status_4 m84M : 8|8@1+ (1,0) [0|255] "" Vector__XXX
	SG_ motor_status_5 m85M : 8|8@1+ (1,0) [0|255] "" Vector__XXX
	SG_ maintenance_success_0 m96M : 8|8@1+ (1,0) [0|255] "" Vector__XXX
	SG_ maintenance_success_1 m97M : 8|8@1+ (1,0) [0|255] "" Vector__XXX
	SG_ maintenance_success_2 m98M : 8|8@1+ (1,0) [0|255] "" Vector__XXX
	SG_ maintenance_success_3 m99M : 8|8@1+ (1,0) [0|255] "" Vector__XXX
	SG_ maintenance_success_4 m100M : 8|8@1+ (1,0) [0|255] "" Vector__XXX
	SG_ maintenance_success_5 m101M : 8|8@1+ (1,0) [0|255] "" Vector__XXX
	SG_ servo_type_0 m112M : 8|8@1+ (1,0) [0|255] "uint8" Vector__XXX
	SG_ servo_type_1 m113M : 8|8@1+ (1,0) [0|255] "uint8" Vector__XXX
	SG_ servo_type_2 m114M : 8|8@1+ (1,0) [0|255] "uint8" Vector__XXX
	SG_ servo_type_3 m115M : 8|8@1+ (1,0) [0|255] "uint8" Vector__XXX
	SG_ servo_type_4 m116M : 8|8@1+ (1,0) [0|255] "uint8" Vector__XXX
	SG_ servo_type_5 m117M : 8|8@1+ (1,0) [0|255] "uint8" Vector__XXX
	SG_ servo_position_max_0 m112M : 16|16@1+ (1,0) [0|65535] "deg" Vector__XXX
	SG_ servo_position_max_1 m113M : 16|16@1+ (1,0) [0|65535] "deg" Vector__XXX
	SG_ servo_position_max_2 m114M : 16|16@1+ (1,0) [0|65535] "deg" Vector__XXX
	SG_ servo_position_max_3 m115M : 16|16@1+ (1,0) [0|65535] "deg" Vector__XXX
	SG_ servo_position_max_4 m116M : 16|16@1+ (1,0) [0|65535] "deg" Vector__XXX
	SG_ servo_position_max_5 m117M : 16|16@1+ (1,0) [0|65535] "deg" Vector__XXX
	SG_ servo_velocity_max_0 m112M : 32|16@1+ (1,0) [0|65535] "deg/s" Vector__XXX
	SG_ servo_velocity_max_1 m113M : 32|16@1+ (1,0) [0|65535] "deg/s" Vector__XXX
	SG_ servo_velocity_max_2 m114M : 32|16@1+ (1,0) [0|65535] "deg/s" Vector__XXX
	SG_ servo_velocity_max_3 m115M : 32|16@1+ (1,0) [0|65535] "deg/s" Vector__XXX
	SG_ servo_velocity_max_4 m116M : 32|16@1+ (1,0) [0|65535] "deg/s" Vector__XXX
	SG_ servo_velocity_max_5 m117M : 32|16@1+ (1,0) [0|65535] "deg/s" Vector__XXX

BO_ 144 STEPPER_PCB_C: 8 Vector__XXX
	SG_ cmd M : 0|8@1+ (1,0) [0|0] "" Vector__XXX
	SG_ pcb_heartbeat_delay m16M : 8|8@1+ (1,0) [0|0] "sec" Vector__XXX
	SG_ led_status m17M : 8|1@1+ (1,0) [0|1] "bool" Vector__XXX
	SG_ motor_rel_pos_target_0 m32M : 8|16@1+ (1,0) [-32768|32767] "deg" Vector__XXX
	SG_ motor_rel_pos_target_1 m33M : 8|16@1- (1,0) [-32768|32767] "deg" Vector__XXX
	SG_ motor_rel_pos_target_2 m34M : 8|16@1- (1,0) [-32768|32767] "deg" Vector__XXX
	SG_ motor_rel_pos_target_3 m35M : 8|16@1- (1,0) [-32768|32767] "deg" Vector__XXX
	SG_ motor_rel_pos_target_4 m36M : 8|16@1- (1,0) [-32768|32767] "deg" Vector__XXX
	SG_ motor_rel_pos_target_5 m37M : 8|16@1- (1,0) [-32768|32767] "deg" Vector__XXX
	SG_ motor_velocity_target_0 m48M : 8|16@1+ (1,0) [-32768|32767] "deg/s" Vector__XXX
	SG_ motor_velocity_target_1 m49M : 8|16@1- (1,0) [-32768|32767] "deg/s" Vector__XXX
	SG_ motor_velocity_target_2 m50M : 8|16@1- (1,0) [-32768|32767] "deg/s" Vector__XXX
	SG_ motor_velocity_target_3 m51M : 8|16@1- (1,0) [-32768|32767] "deg/s" Vector__XXX
	SG_ motor_velocity_target_4 m52M : 8|16@1- (1,0) [-32768|32767] "deg/s" Vector__XXX
	SG_ motor_velocity_target_5 m53M : 8|16@1- (1,0) [-32768|32767] "deg/s" Vector__XXX
	SG_ motor_state_req_event_0 m64M : 8|1@1+ (1,0) [0|1] "bool" Vector__XXX
	SG_ motor_state_req_event_1 m65M : 8|1@1- (1,0) [0|1] "bool" Vector__XXX
	SG_ motor_state_req_event_2 m66M : 8|1@1- (1,0) [0|1] "bool" Vector__XXX
	SG_ motor_state_req_event_3 m67M : 8|1@1- (1,0) [0|1] "bool" Vector__XXX
	SG_ motor_state_req_event_4 m68M : 8|1@1- (1,0) [0|1] "bool" Vector__XXX
	SG_ motor_state_req_event_5 m69M : 8|1@1- (1,0) [0|1] "bool" Vector__XXX
	SG_ motor_status_req_event_0 m80M : 8|1@1+ (1,0) [0|1] "bool" Vector__XXX
	SG_ motor_status_req_event_1 m81M : 8|1@1- (1,0) [0|1] "bool" Vector__XXX
	SG_ motor_status_req_event_2 m82M : 8|1@1- (1,0) [0|1] "bool" Vector__XXX
	SG_ motor_status_req_event_3 m83M : 8|1@1- (1,0) [0|1] "bool" Vector__XXX
	SG_ motor_status_req_event_4 m84M : 8|1@1- (1,0) [0|1] "bool" Vector__XXX
	SG_ motor_status_req_event_5 m85M : 8|1@1- (1,0) [0|1] "bool" Vector__XXX
	SG_ stepper_spec_req_event_0 m112M : 8|1@1+ (1,0) [0|1] "bool" Vector__XXX
	SG_ stepper_spec_req_event_1 m113M : 8|1@1+ (1,0) [0|1] "bool" Vector__XXX
	SG_ stepper_spec_req_event_2 m114M : 8|1@1+ (1,0) [0|1] "bool" Vector__XXX
	SG_ stepper_spec_req_event_3 m115M : 8|1@1+ (1,0) [0|1] "bool" Vector__XXX
	SG_ stepper_spec_req_event_4 m116M : 8|1@1+ (1,0) [0|1] "bool" Vector__XXX
	SG_ stepper_spec_req_event_5 m117M : 8|1@1+ (1,0) [0|1] "bool" Vector__XXX

BO_ 145 STEPPER_PCB_R: 8 Vector__XXX
	SG_ req M : 0|8@1+ (1,0) [0|0] "" Vector__XXX
	SG_ heartbeat_success m16M : 8|8@1+ (1,0) [0|1] "bool" Vector__XXX
	SG_ led_success m17M : 8|8@1+ (1,0) [0|1] "bool" Vector__XXX
	SG_ motor_position_0 m32M : 8|16@1- (1,0) [-32768|32767] "deg" Vector__XXX
	SG_ motor_position_1 m33M : 8|16@1- (1,0) [-32768|32767] "deg" Vector__XXX
	SG_ motor_position_2 m34M : 8|16@1- (1,0) [-32768|32767] "deg" Vector__XXX
	SG_ motor_position_3 m35M : 8|16@1- (1,0) [-32768|32767] "deg" Vector__XXX
	SG_ motor_position_4 m36M : 8|16@1- (1,0) [-32768|32767] "deg" Vector__XXX
	SG_ motor_position_5 m37M : 8|16@1- (1,0) [-32768|32767] "deg" Vector__XXX
	SG_ motor_velocity_0 m32M : 24|16@1- (1,0) [-32768|32767] "deg/s" Vector__XXX
	SG_ motor_velocity_1 m33M : 24|16@1- (1,0) [-32768|32767] "deg/s" Vector__XXX
	SG_ motor_velocity_2 m34M : 24|16@1- (1,0) [-32768|32767] "deg/s" Vector__XXX
	SG_ motor_velocity_3 m35M : 24|16@1- (1,0) [-32768|32767] "deg/s" Vector__XXX
	SG_ motor_velocity_4 m36M : 24|16@1- (1,0) [-32768|32767] "deg/s" Vector__XXX
	SG_ motor_velocity_5 m37M : 24|16@1- (1,0) [-32768|32767] "deg/s" Vector__XXX
	SG_ motor_position_6 m48M : 8|16@1- (1,0) [-32768|32767] "deg" Vector__XXX
	SG_ motor_position_7 m49M : 8|16@1- (1,0) [-32768|32767] "deg" Vector__XXX
	SG_ motor_position_8 m50M : 8|16@1- (1,0) [-32768|32767] "deg" Vector__XXX
	SG_ motor_position_9 m51M : 8|16@1- (1,0) [-32768|32767] "deg" Vector__XXX
	SG_ motor_position_10 m52M : 8|16@1- (1,0) [-32768|32767] "deg" Vector__XXX
	SG_ motor_position_11 m53M : 8|16@1- (1,0) [-32768|32767] "deg" Vector__XXX
	SG_ motor_velocity_6 m48M : 24|16@1- (1,0) [-32768|32767] "deg/s" Vector__XXX
	SG_ motor_velocity_7 m49M : 24|16@1- (1,0) [-32768|32767] "deg/s" Vector__XXX
	SG_ motor_velocity_8 m50M : 24|16@1- (1,0) [-32768|32767] "deg/s" Vector__XXX
	SG_ motor_velocity_9 m51M : 24|16@1- (1,0) [-32768|32767] "deg/s" Vector__XXX
	SG_ motor_velocity_10 m52M : 24|16@1- (1,0) [-32768|32767] "deg/s" Vector__XXX
	SG_ motor_velocity_11 m53M : 24|16@1- (1,0) [-32768|32767] "deg/s" Vector__XXX
	SG_ motor_position_12 m64M : 8|16@1- (1,0) [-32768|32767] "deg" Vector__XXX
	SG_ motor_position_13 m65M : 8|16@1- (1,0) [-32768|32767] "deg" Vector__XXX
	SG_ motor_position_14 m66M : 8|16@1- (1,0) [-32768|32767] "deg" Vector__XXX
	SG_ motor_position_15 m67M : 8|16@1- (1,0) [-32768|32767] "deg" Vector__XXX
	SG_ motor_position_16 m68M : 8|16@1- (1,0) [-32768|32767] "deg" Vector__XXX
	SG_ motor_position_17 m69M : 8|16@1- (1,0) [-32768|32767] "deg" Vector__XXX
	SG_ motor_velocity_12 m64M : 24|16@1- (1,0) [-32768|32767] "deg/s" Vector__XXX
	SG_ motor_velocity_13 m65M : 24|16@1- (1,0) [-32768|32767] "deg/s" Vector__XXX
	SG_ motor_velocity_14 m66M : 24|16@1- (1,0) [-32768|32767] "deg/s" Vector__XXX
	SG_ motor_velocity_15 m67M : 24|16@1- (1,0) [-32768|32767] "deg/s" Vector__XXX
	SG_ motor_velocity_16 m68M : 24|16@1- (1,0) [-32768|32767] "deg/s" Vector__XXX
	SG_ motor_velocity_17 m69M : 24|16@1- (1,0) [-32768|32767] "deg/s" Vector__XXX
	SG_ motor_status_0 m80M : 8|8@1+ (1,0) [0|255] "" Vector__XXX
	SG_ motor_status_1 m81M : 8|8@1+ (1,0) [0|255] "" Vector__XXX
	SG_ motor_status_2 m82M : 8|8@1+ (1,0) [0|255] "" Vector__XXX
	SG_ motor_status_3 m83M : 8|8@1+ (1,0) [0|255] "" Vector__XXX
	SG_ motor_status_4 m84M : 8|8@1+ (1,0) [0|255] "" Vector__XXX
	SG_ motor_status_5 m85M : 8|8@1+ (1,0) [0|255] "" Vector__XXX
	SG_ maintenance_success_0 m96M : 8|8@1+ (1,0) [0|255] "" Vector__XXX
	SG_ maintenance_success_1 m97M : 8|8@1+ (1,0) [0|255] "" Vector__XXX
	SG_ maintenance_success_2 m98M : 8|8@1+ (1,0) [0|255] "" Vector__XXX
	SG_ maintenance_success_3 m99M : 8|8@1+ (1,0) [0|255] "" Vector__XXX
	SG_ maintenance_success_4 m100M : 8|8@1+ (1,0) [0|255] "" Vector__XXX
	SG_ maintenance_success_5 m101M : 8|8@1+ (1,0) [0|255] "" Vector__XXX
	SG_ stepper_velocity_max_0 m112M : 8|16@1+ (1,0) [0|65535] "deg/s" Vector__XXX
	SG_ step_angle_0 m112M : 24|8@1+ (1,0) [0|255] "deg" Vector__XXX
	SG_ stepper_velocity_max_1 m113M : 8|16@1+ (1,0) [0|65535] "deg/s" Vector__XXX
	SG_ step_angle_1 m113M : 24|8@1+ (1,0) [0|255] "deg" Vector__XXX
	SG_ stepper_velocity_max_2 m114M : 8|16@1+ (1,0) [0|65535] "deg/s" Vector__XXX
	SG_ step_angle_2 m114M : 24|8@1+ (1,0) [0|255] "deg" Vector__XXX
	SG_ stepper_velocity_max_3 m115M : 8|16@1+ (1,0) [0|65535] "deg/s" Vector__XXX
	SG_ step_angle_3 m115M : 24|8@1+ (1,0) [0|255] "deg" Vector__XXX
	SG_ stepper_velocity_max_4 m116M : 8|16@1+ (1,0) [0|65535] "deg/s" Vector__XXX
	SG_ step_angle_4 m116M : 24|8@1+ (1,0) [0|255] "deg" Vector__XXX
	SG_ stepper_velocity_max_5 m117M : 8|16@1+ (1,0) [0|65535] "deg/s" Vector__XXX
	SG_ step_angle_5 m117M : 24|8@1+ (1,0) [0|255] "deg" Vector__XXX

CM_ SG_ 128 cmd "This is used to mux the remaining bytes of 0x080 messages.";
CM_ SG_ 128 pcb_heartbeat_delay "pcb_heartbeat_delay = 0 | PCB will send no heartbeats. pcb_heartbeat_delay = 1-255 | PCB will transmit a heartbeat at an interval of n seconds.";
CM_ SG_ 128 led_status "If led_status = false | The onboard PCB LED will be turned off. If led_status = true | The onboard PCB LED will be turned on.";
CM_ SG_ 128 motor_position_target_0 "Set the absolute position of the servo in integer units degrees. Note: Some servos have built turn limits while others allow continuous movement. Uses typical turn sign convention: counter-clockwise (+) and clockwise (-).";
CM_ SG_ 128 motor_velocity_target_0 "Set the relative velocity of the servo in integer units degrees per second. Note: This option will not work for servos that do not have continuous turn mode. Uses typical turn sign convention: counter-clockwise (+) and clockwise (-).";

CM_ SG_ 129 heartbeat_success "success = 0 | Failed to complete command success = 1 | Command sent successfully";
CM_ SG_ 129 motor_position_0 "The absolute position of the servo in integer units degrees. Uses typical turn sign convention: counter-clockwise (+) and clockwise (-).";
CM_ SG_ 129 motor_velocity_0 "The relative velocity of the servo in integer units degrees per second. Uses typical turn sign convention: counter-clockwise (+) and clockwise (-).";
CM_ SG_ 128 maintenance_cmd_0 "motor_id	| Identifies which motor we are working with maintenance_cmd_# = 0 | Set current multi-turn position to ROM as zero maintenance_cmd_# = 1 | Stop Motor maintenance_cmd_# = 2 | Shutdown Motor maintenance_cmd_# = 3	| Clear Errors";
CM_ SG_ 128 maintenance_cmd_1 "motor_id	| Identifies which motor we are working with maintenance_cmd_# = 0 | Set current multi-turn position to ROM as zero maintenance_cmd_# = 1 | Stop Motor maintenance_cmd_# = 2 | Shutdown Motor maintenance_cmd_# = 3	| Clear Errors";
CM_ SG_ 128 maintenance_cmd_2 "motor_id	| Identifies which motor we are working with maintenance_cmd_# = 0 | Set current multi-turn position to ROM as zero maintenance_cmd_# = 1 | Stop Motor maintenance_cmd_# = 2 | Shutdown Motor maintenance_cmd_# = 3	| Clear Errors";
CM_ SG_ 128 maintenance_cmd_3 "motor_id	| Identifies which motor we are working with maintenance_cmd_# = 0 | Set current multi-turn position to ROM as zero maintenance_cmd_# = 1 | Stop Motor maintenance_cmd_# = 2 | Shutdown Motor maintenance_cmd_# = 3	| Clear Errors";
CM_ SG_ 128 maintenance_cmd_4 "motor_id	| Identifies which motor we are working with maintenance_cmd_# = 0 | Set current multi-turn position to ROM as zero maintenance_cmd_# = 1 | Stop Motor maintenance_cmd_# = 2 | Shutdown Motor maintenance_cmd_# = 3	| Clear Errors";
CM_ SG_ 128 maintenance_cmd_5 "motor_id	| Identifies which motor we are working with maintenance_cmd_# = 0 | Set current multi-turn position to ROM as zero maintenance_cmd_# = 1 | Stop Motor maintenance_cmd_# = 2 | Shutdown Motor maintenance_cmd_# = 3	| Clear Errors";
CM_ SG_ 128 motor_state_req_event_0 "Response will contain current absolute position and velocity of a particular motor.";
CM_ SG_ 128 motor_status_req_event_1 "Response will contain the current status of a particular motor.";
CM_ SG_ 128 motor_status_req_event_2 "Response will contain the current status of a particular motor.";
CM_ SG_ 128 motor_status_req_event_3 "Response will contain the current status of a particular motor.";
CM_ SG_ 128 motor_status_req_event_4 "Response will contain the current status of a particular motor.";
CM_ SG_ 128 motor_status_req_event_5 "Response will contain the current status of a particular motor.";
CM_ SG_ 129 led_success "led_success = 0 | Failed to complete command led_success = 1 | Command sent successfully";
CM_ SG_ 129 motor_status_0 "motor_status_# = 0 | Undefined motor_status_# = 1 | Idle motor_status_# = 2	| Startup Sequence motor_status_# = 3 | Error (Invalid Request) motor_status_# = 4 | Error (Motor Disarmed) motor_status_# = 5 | Error (Motor Failed) motor_status_# = 6 | ";
CM_ SG_ 129 motor_status_1 "motor_status_# = 0 | Undefined motor_status_# = 1 | Idle motor_status_# = 2	| Startup Sequence motor_status_# = 3 | Error (Invalid Request) motor_status_# = 4 | Error (Motor Disarmed) motor_status_# = 5 | Error (Motor Failed) motor_status_# = 6 | ";
CM_ SG_ 129 motor_status_2 "motor_status_# = 0 | Undefined motor_status_# = 1 | Idle motor_status_# = 2	| Startup Sequence motor_status_# = 3 | Error (Invalid Request) motor_status_# = 4 | Error (Motor Disarmed) motor_status_# = 5 | Error (Motor Failed) motor_status_# = 6 | ";
CM_ SG_ 129 motor_status_3 "motor_status_# = 0 | Undefined motor_status_# = 1 | Idle motor_status_# = 2	| Startup Sequence motor_status_# = 3 | Error (Invalid Request) motor_status_# = 4 | Error (Motor Disarmed) motor_status_# = 5 | Error (Motor Failed) motor_status_# = 6 | ";
CM_ SG_ 129 motor_status_4 "motor_status_# = 0 | Undefined motor_status_# = 1 | Idle motor_status_# = 2	| Startup Sequence motor_status_# = 3 | Error (Invalid Request) motor_status_# = 4 | Error (Motor Disarmed) motor_status_# = 5 | Error (Motor Failed) motor_status_# = 6 | ";
CM_ SG_ 129 motor_status_5 "motor_status_# = 0 | Undefined motor_status_# = 1 | Idle motor_status_# = 2	| Startup Sequence motor_status_# = 3 | Error (Invalid Request) motor_status_# = 4 | Error (Motor Disarmed) motor_status_# = 5 | Error (Motor Failed) motor_status_# = 6 | ";
CM_ SG_ 129 maintenance_success_0 "maintenance_success_# = 0 | Failed to complete command maintenance_success_# = 1	| Command sent successfully";
CM_ SG_ 129 maintenance_success_1 "maintenance_success_# = 0 | Failed to complete command maintenance_success_# = 1	| Command sent successfully";
CM_ SG_ 129 maintenance_success_2 "maintenance_success_# = 0 | Failed to complete command maintenance_success_# = 1	| Command sent successfully";
CM_ SG_ 129 maintenance_success_3 "maintenance_success_# = 0 | Failed to complete command maintenance_success_# = 1	| Command sent successfully";
CM_ SG_ 129 maintenance_success_4 "maintenance_success_# = 0 | Failed to complete command maintenance_success_# = 1	| Command sent successfully";
CM_ SG_ 129 maintenance_success_5 "maintenance_success_# = 0 | Failed to complete command maintenance_success_# = 1	| Command sent successfully";
CM_ SG_ 129 servo_type_0 "servo_type_# = 0 | Undefined servo_type_# = 1 | Standard servo_type_# = 2	| Continuous";
CM_ SG_ 129 servo_type_1 "servo_type_# = 0 | Undefined servo_type_# = 1 | Standard servo_type_# = 2	| Continuous";
CM_ SG_ 129 servo_type_2 "servo_type_# = 0 | Undefined servo_type_# = 1	| Standard servo_type_# = 2	| Continuous";
CM_ SG_ 129 servo_type_3 "servo_type_# = 0 | Undefined servo_type_# = 1	| Standard servo_type_# = 2	| Continuous";
CM_ SG_ 129 servo_type_4 "servo_type_# = 0 | Undefined servo_type_# = 1	| Standard servo_type_# = 2	| Continuous";
CM_ SG_ 129 servo_type_5 "servo_type_# = 0 | Undefined servo_type_# = 1	| Standard servo_type_# = 2	| Continuous";
CM_ SG_ 129 servo_position_max_0 "servo_position_max_# = 0 - 65,535	| Maximum servo position in degrees. If it is 0, it is | continuous. Returns in little endian.";
CM_ SG_ 129 servo_position_max_1 "servo_position_max_# = 0 - 65,535	| Maximum servo position in degrees. If it is 0, it is | continuous. Returns in little endian.";
CM_ SG_ 129 servo_position_max_2 "servo_position_max_# = 0 - 65,535	| Maximum servo position in degrees. If it is 0, it is | continuous. Returns in little endian.";
CM_ SG_ 129 servo_position_max_3 "servo_position_max_# = 0 - 65,535	| Maximum servo position in degrees. If it is 0, it is | continuous. Returns in little endian.";
CM_ SG_ 129 servo_position_max_4 "servo_position_max_# = 0 - 65,535	| Maximum servo position in degrees. If it is 0, it is | continuous. Returns in little endian.";
CM_ SG_ 129 servo_position_max_5 "servo_position_max_# = 0 - 65,535	| Maximum servo position in degrees. If it is 0, it is | continuous. Returns in little endian.";
CM_ SG_ 129 servo_velocity_max_0 "servo_velocity_max _# = 0 - 65,535 | Maximum servo velocity in degrees. Returns in little | endian.";
CM_ SG_ 129 servo_velocity_max_1 "servo_velocity_max _# = 0 - 65,535 | Maximum servo velocity in degrees. Returns in little | endian.";
CM_ SG_ 129 servo_velocity_max_2 "servo_velocity_max _# = 0 - 65,535 | Maximum servo velocity in degrees. Returns in little | endian.";
CM_ SG_ 129 servo_velocity_max_3 "servo_velocity_max _# = 0 - 65,535 | Maximum servo velocity in degrees. Returns in little | endian.";
CM_ SG_ 129 servo_velocity_max_4 "servo_velocity_max _# = 0 - 65,535 | Maximum servo velocity in degrees. Returns in little | endian.";
CM_ SG_ 129 servo_velocity_max_5 "servo_velocity_max _# = 0 - 65,535 | Maximum servo velocity in degrees. Returns in little | endian.";
CM_ SG_ 128 servo_spec_req_0 "servo_spec_req_event_# = 0 | Don’t validate the request servo_spec_req_event_# = 1 | Validate the request";
CM_ SG_ 128 servo_spec_req_1 "servo_spec_req_event_# = 0 | Don’t validate the request servo_spec_req_event_# = 1 | Validate the request";
CM_ SG_ 128 servo_spec_req_2 "servo_spec_req_event_# = 0 | Don’t validate the request servo_spec_req_event_# = 1 | Validate the request";
CM_ SG_ 128 servo_spec_req_3 "servo_spec_req_event_# = 0 | Don’t validate the request servo_spec_req_event_# = 1 | Validate the request";
CM_ SG_ 128 servo_spec_req_4 "servo_spec_req_event_# = 0 | Don’t validate the request servo_spec_req_event_# = 1 | Validate the request";
CM_ SG_ 128 servo_spec_req_5 "servo_spec_req_event_# = 0 | Don’t validate the request servo_spec_req_event_# = 1 | Validate the request";
CM_ SG_ 129 heartbeat_success "success = 0 | Failed to complete command success = 1 | Command sent successfully";
CM_ SG_ 144 pcb_heartbeat_delay "pcb_heartbeat_delay = 0 | PCB will send no heartbeats. pcb_heartbeat_delay = 1-255 | PCB will transmit a heartbeat at an interval of n seconds.";
CM_ SG_ 144 led_status "If led_status = false | The onboard PCB LED will be turned off. If led_status = true | The onboard PCB LED will be turned on.";
CM_ SG_ 144 motor_rel_pos_target_0 "motor_rel_pos_target_# | Input position will be interpreted in little endian.";
CM_ SG_ 144 motor_velocity_target_0 "Set the relative velocity of the servo in integer units degrees per second. Note: This option will not work for servos that do not have continuous turn mode. Uses typical turn sign convention: counter-clockwise (+) and clockwise (-).";
CM_ SG_ 144 motor_state_req_event_0 "Response will contain current absolute position and velocity of a particular motor.";
CM_ SG_ 129 req "This is used to mux the remaining bytes of 0x081 messages.";
CM_ SG_ 144 cmd "This is used to mux the remaining bytes of 0x090 messages.";
CM_ SG_ 145 req "This is used to mux the remaining bytes of 0x091 messages.";
CM_ SG_ 145 led_success "led_success = 0 | Failed to complete command led_success = 1 | Command sent successfully";
CM_ SG_ 145 stepper_velocity_max_0 "stepper_velocity_max _# = 0 - 65,535 | Maximum stepper velocity in degrees/sec. | Returns in little endian.";
CM_ SG_ 145 step_angle_0 "step_angle_# = 0 - 255 | Returns step angle for this particular motor in | degrees. The maximum possible step angle to | input is 25.5. Returns in little endian.";
CM_ SG_ 145 stepper_velocity_max_1 "stepper_velocity_max _# = 0 - 65,535 | Maximum stepper velocity in degrees/sec. | Returns in little endian.";
CM_ SG_ 145 step_angle_1 "step_angle_# = 0 - 255 | Returns step angle for this particular motor in | degrees. The maximum possible step angle to | input is 25.5. Returns in little endian.";
CM_ SG_ 145 stepper_velocity_max_2 "stepper_velocity_max _# = 0 - 65,535 | Maximum stepper velocity in degrees/sec. | Returns in little endian.";
CM_ SG_ 145 step_angle_2 "step_angle_# = 0 - 255 | Returns step angle for this particular motor in | degrees. The maximum possible step angle to | input is 25.5. Returns in little endian.";
CM_ SG_ 145 stepper_velocity_max_3 "stepper_velocity_max _# = 0 - 65,535 | Maximum stepper velocity in degrees/sec. | Returns in little endian.";
CM_ SG_ 145 step_angle_3 "step_angle_# = 0 - 255 | Returns step angle for this particular motor in | degrees. The maximum possible step angle to | input is 25.5. Returns in little endian.";
CM_ SG_ 145 stepper_velocity_max_4 "stepper_velocity_max _# = 0 - 65,535 | Maximum stepper velocity in degrees/sec. | Returns in little endian.";
CM_ SG_ 145 step_angle_4 "step_angle_# = 0 - 255 | Returns step angle for this particular motor in | degrees. The maximum possible step angle to | input is 25.5. Returns in little endian.";
CM_ SG_ 145 stepper_velocity_max_5 "stepper_velocity_max _# = 0 - 65,535 | Maximum stepper velocity in degrees/sec. | Returns in little endian.";
CM_ SG_ 145 step_angle_5 "step_angle_# = 0 - 255 | Returns step angle for this particular motor in | degrees. The maximum possible step angle to | input is 25.5. Returns in little endian.";

BA_DEF_ BO_  "VFrameFormat" ENUM  "StandardCAN","ExtendedCAN","reserved","J1939PG";
BA_DEF_  "DatabaseVersion" STRING ;
BA_DEF_  "BusType" STRING ;
BA_DEF_  "ProtocolType" STRING ;
BA_DEF_  "DatabaseCompiler" STRING ;
BA_DEF_DEF_  "VFrameFormat" "J1939PG";
BA_DEF_DEF_  "DatabaseVersion" "DEMO PLUS";
BA_DEF_DEF_  "BusType" "";
BA_DEF_DEF_  "ProtocolType" "";
BA_DEF_DEF_  "DatabaseCompiler" "";
BA_ "ProtocolType" "J1939";
BA_ "BusType" "CAN";
BA_ "DatabaseCompiler" "CSS ELECTRONICS (WWW.CSSELECTRONICS.COM)";
BA_ "DatabaseVersion" "1.0.0";

SG_MUL_VAL_ 128 pcb_heartbeat_delay cmd 16-16;
SG_MUL_VAL_ 128 led_status cmd 17-17;

SG_MUL_VAL_ 128 motor_position_target_0 cmd 32-32;
SG_MUL_VAL_ 128 motor_position_target_1 cmd 33-33;
SG_MUL_VAL_ 128 motor_position_target_2 cmd 34-34;
SG_MUL_VAL_ 128 motor_position_target_3 cmd 35-35;
SG_MUL_VAL_ 128 motor_position_target_4 cmd 36-36;
SG_MUL_VAL_ 128 motor_position_target_5 cmd 37-37;

SG_MUL_VAL_ 128 motor_velocity_target_0 cmd 48-48;
SG_MUL_VAL_ 128 motor_velocity_target_1 cmd 49-49;
SG_MUL_VAL_ 128 motor_velocity_target_2 cmd 50-50;
SG_MUL_VAL_ 128 motor_velocity_target_3 cmd 51-51;
SG_MUL_VAL_ 128 motor_velocity_target_4 cmd 52-52;
SG_MUL_VAL_ 128 motor_velocity_target_5 cmd 53-53;

SG_MUL_VAL_ 129 heartbeat_success req 16-16;

SG_MUL_VAL_ 129 motor_position_0 req 32-32;
SG_MUL_VAL_ 129 motor_velocity_0 req 32-32;
SG_MUL_VAL_ 129 motor_position_1 req 33-33;
SG_MUL_VAL_ 129 motor_velocity_1 req 33-33;
SG_MUL_VAL_ 129 motor_position_2 req 34-34;
SG_MUL_VAL_ 129 motor_velocity_2 req 34-34;
SG_MUL_VAL_ 129 motor_position_3 req 35-35;
SG_MUL_VAL_ 129 motor_velocity_3 req 35-35;
SG_MUL_VAL_ 129 motor_position_4 req 36-36;
SG_MUL_VAL_ 129 motor_velocity_4 req 36-36;
SG_MUL_VAL_ 129 motor_position_5 req 37-37;
SG_MUL_VAL_ 129 motor_velocity_5 req 37-37;

SG_MUL_VAL_ 129 motor_position_6 req 48-48;
SG_MUL_VAL_ 129 motor_velocity_6 req 48-48;
SG_MUL_VAL_ 129 motor_position_7 req 49-49;
SG_MUL_VAL_ 129 motor_velocity_7 req 49-49;
SG_MUL_VAL_ 129 motor_position_8 req 50-50;
SG_MUL_VAL_ 129 motor_velocity_8 req 50-50;
SG_MUL_VAL_ 129 motor_position_9 req 51-51;
SG_MUL_VAL_ 129 motor_velocity_9 req 51-51;
SG_MUL_VAL_ 129 motor_position_10 req 52-52;
SG_MUL_VAL_ 129 motor_velocity_10 req 52-52;
SG_MUL_VAL_ 129 motor_position_11 req 53-53;
SG_MUL_VAL_ 129 motor_velocity_11 req 53-53;

SG_MUL_VAL_ 129 motor_position_12 req 64-64;
SG_MUL_VAL_ 129 motor_velocity_12 req 64-64;
SG_MUL_VAL_ 129 motor_position_13 req 65-65;
SG_MUL_VAL_ 129 motor_velocity_13 req 65-65;
SG_MUL_VAL_ 129 motor_position_14 req 66-66;
SG_MUL_VAL_ 129 motor_velocity_14 req 66-66;
SG_MUL_VAL_ 129 motor_position_15 req 67-67;
SG_MUL_VAL_ 129 motor_velocity_15 req 67-67;
SG_MUL_VAL_ 129 motor_position_16 req 68-68;
SG_MUL_VAL_ 129 motor_velocity_16 req 68-68;
SG_MUL_VAL_ 129 motor_position_17 req 69-69;
SG_MUL_VAL_ 129 motor_velocity_17 req 69-69;

SG_MUL_VAL_ 128 motor_state_req_event_0 cmd 64-64;
SG_MUL_VAL_ 128 motor_state_req_event_1 cmd 65-65;
SG_MUL_VAL_ 128 motor_state_req_event_2 cmd 66-66;
SG_MUL_VAL_ 128 motor_state_req_event_3 cmd 67-67;
SG_MUL_VAL_ 128 motor_state_req_event_4 cmd 68-68;
SG_MUL_VAL_ 128 motor_state_req_event_5 cmd 69-69;
SG_MUL_VAL_ 128 motor_status_req_event_0 cmd 80-80;
SG_MUL_VAL_ 128 motor_status_req_event_1 cmd 81-81;
SG_MUL_VAL_ 128 motor_status_req_event_2 cmd 82-82;
SG_MUL_VAL_ 128 motor_status_req_event_3 cmd 83-83;
SG_MUL_VAL_ 128 motor_status_req_event_4 cmd 84-84;
SG_MUL_VAL_ 128 motor_status_req_event_5 cmd 85-85;
SG_MUL_VAL_ 128 maintenance_cmd_0 cmd 96-96;
SG_MUL_VAL_ 128 maintenance_cmd_1 cmd 97-97;
SG_MUL_VAL_ 128 maintenance_cmd_2 cmd 98-98;
SG_MUL_VAL_ 128 maintenance_cmd_3 cmd 99-99;
SG_MUL_VAL_ 128 maintenance_cmd_4 cmd 100-100;
SG_MUL_VAL_ 128 maintenance_cmd_5 cmd 101-101;
SG_MUL_VAL_ 128 servo_spec_req_0 cmd 112-112;
SG_MUL_VAL_ 128 servo_spec_req_1 cmd 113-113;
SG_MUL_VAL_ 128 servo_spec_req_2 cmd 114-114;
SG_MUL_VAL_ 128 servo_spec_req_3 cmd 115-115;
SG_MUL_VAL_ 128 servo_spec_req_4 cmd 116-116;
SG_MUL_VAL_ 128 servo_spec_req_5 cmd 117-117;
SG_MUL_VAL_ 129 motor_status_0 req 80-80;
SG_MUL_VAL_ 129 motor_status_1 req 81-81;
SG_MUL_VAL_ 129 motor_status_2 req 82-82;
SG_MUL_VAL_ 129 motor_status_3 req 83-83;
SG_MUL_VAL_ 129 motor_status_4 req 84-84;
SG_MUL_VAL_ 129 motor_status_5 req 85-85;
SG_MUL_VAL_ 129 maintenance_success_0 req 96-96;
SG_MUL_VAL_ 129 maintenance_success_1 req 97-97;
SG_MUL_VAL_ 129 maintenance_success_2 req 98-98;
SG_MUL_VAL_ 129 maintenance_success_3 req 99-99;
SG_MUL_VAL_ 129 maintenance_success_4 req 100-100;
SG_MUL_VAL_ 129 maintenance_success_5 req 101-101;
SG_MUL_VAL_ 129 servo_type_0 req 112-112;
SG_MUL_VAL_ 129 servo_type_1 req 113-113;
SG_MUL_VAL_ 129 servo_type_2 req 114-114;
SG_MUL_VAL_ 129 servo_type_3 req 115-115;
SG_MUL_VAL_ 129 servo_type_4 req 116-116;
SG_MUL_VAL_ 129 servo_type_5 req 117-117;
SG_MUL_VAL_ 129 servo_position_max_0 req 112-112;
SG_MUL_VAL_ 129 servo_position_max_1 req 113-113;
SG_MUL_VAL_ 129 servo_position_max_2 req 114-114;
SG_MUL_VAL_ 129 servo_position_max_3 req 115-115;
SG_MUL_VAL_ 129 servo_position_max_4 req 116-116;
SG_MUL_VAL_ 129 servo_position_max_5 req 117-117;
SG_MUL_VAL_ 129 servo_velocity_max_0 req 112-112;
SG_MUL_VAL_ 129 servo_velocity_max_1 req 113-113;
SG_MUL_VAL_ 129 servo_velocity_max_2 req 114-114;
SG_MUL_VAL_ 129 servo_velocity_max_3 req 115-115;
SG_MUL_VAL_ 129 servo_velocity_max_4 req 116-116;
SG_MUL_VAL_ 144 pcb_heartbeat_delay cmd 16-16;
SG_MUL_VAL_ 145 heartbeat_success req 16-16;
SG_MUL_VAL_ 144 led_status cmd 17-17;
SG_MUL_VAL_ 144 motor_rel_pos_target_0 cmd 32-32;
SG_MUL_VAL_ 144 motor_rel_pos_target_1 cmd 33-33;
SG_MUL_VAL_ 144 motor_rel_pos_target_2 cmd 34-34;
SG_MUL_VAL_ 144 motor_rel_pos_target_3 cmd 35-35;
SG_MUL_VAL_ 144 motor_rel_pos_target_4 cmd 36-36;
SG_MUL_VAL_ 144 motor_rel_pos_target_5 cmd 37-37;
SG_MUL_VAL_ 144 motor_velocity_target_0 cmd 48-48;
SG_MUL_VAL_ 144 motor_velocity_target_1 cmd 49-49;
SG_MUL_VAL_ 144 motor_velocity_target_2 cmd 50-50;
SG_MUL_VAL_ 144 motor_velocity_target_3 cmd 51-51;
SG_MUL_VAL_ 144 motor_velocity_target_4 cmd 52-52;
SG_MUL_VAL_ 144 motor_velocity_target_5 cmd 53-53;
SG_MUL_VAL_ 144 motor_state_req_event_0 cmd 64-64;
SG_MUL_VAL_ 144 motor_state_req_event_1 cmd 65-65;
SG_MUL_VAL_ 144 motor_state_req_event_2 cmd 66-66;
SG_MUL_VAL_ 144 motor_state_req_event_3 cmd 67-67;
SG_MUL_VAL_ 144 motor_state_req_event_4 cmd 68-68;
SG_MUL_VAL_ 144 motor_state_req_event_5 cmd 69-69;
SG_MUL_VAL_ 144 motor_status_req_event_0 cmd 80-80;
SG_MUL_VAL_ 144 motor_status_req_event_1 cmd 81-81;
SG_MUL_VAL_ 144 motor_status_req_event_2 cmd 82-82;
SG_MUL_VAL_ 144 motor_status_req_event_3 cmd 83-83;
SG_MUL_VAL_ 144 motor_status_req_event_4 cmd 84-84;
SG_MUL_VAL_ 144 motor_status_req_event_5 cmd 85-85;
SG_MUL_VAL_ 145 led_success req 17-17;
SG_MUL_VAL_ 145 motor_position_0 req 32-32;
SG_MUL_VAL_ 145 motor_velocity_0 req 32-32;
SG_MUL_VAL_ 145 motor_position_1 req 33-33;
SG_MUL_VAL_ 145 motor_velocity_1 req 33-33;
SG_MUL_VAL_ 145 motor_position_2 req 34-34;
SG_MUL_VAL_ 145 motor_velocity_2 req 34-34;
SG_MUL_VAL_ 145 motor_position_3 req 35-35;
SG_MUL_VAL_ 145 motor_velocity_3 req 35-35;
SG_MUL_VAL_ 145 motor_position_4 req 36-36;
SG_MUL_VAL_ 145 motor_velocity_4 req 36-36;
SG_MUL_VAL_ 145 motor_position_5 req 37-37;
SG_MUL_VAL_ 145 motor_velocity_5 req 37-37;
SG_MUL_VAL_ 145 motor_position_6 req 48-48;
SG_MUL_VAL_ 145 motor_velocity_6 req 48-48;
SG_MUL_VAL_ 145 motor_position_7 req 49-49;
SG_MUL_VAL_ 145 motor_velocity_7 req 49-49;
SG_MUL_VAL_ 145 motor_position_8 req 50-50;
SG_MUL_VAL_ 145 motor_velocity_8 req 50-50;
SG_MUL_VAL_ 145 motor_position_9 req 51-51;
SG_MUL_VAL_ 145 motor_velocity_9 req 51-51;
SG_MUL_VAL_ 145 motor_position_10 req 52-52;
SG_MUL_VAL_ 145 motor_velocity_10 req 52-52;
SG_MUL_VAL_ 145 motor_position_11 req 53-53;
SG_MUL_VAL_ 145 motor_velocity_11 req 53-53;
SG_MUL_VAL_ 145 motor_position_12 req 64-64;
SG_MUL_VAL_ 145 motor_velocity_12 req 64-64;
SG_MUL_VAL_ 145 motor_position_13 req 65-65;
SG_MUL_VAL_ 145 motor_velocity_13 req 65-65;
SG_MUL_VAL_ 145 motor_position_14 req 66-66;
SG_MUL_VAL_ 145 motor_velocity_14 req 66-66;
SG_MUL_VAL_ 145 motor_position_15 req 67-67;
SG_MUL_VAL_ 145 motor_velocity_15 req 67-67;
SG_MUL_VAL_ 145 motor_position_16 req 68-68;
SG_MUL_VAL_ 145 motor_velocity_16 req 68-68;
SG_MUL_VAL_ 145 motor_position_17 req 69-69;
SG_MUL_VAL_ 145 motor_velocity_17 req 69-69;
SG_MUL_VAL_ 145 motor_status_0 req 80-80;
SG_MUL_VAL_ 145 motor_status_1 req 81-81;
SG_MUL_VAL_ 145 motor_status_2 req 82-82;
SG_MUL_VAL_ 145 motor_status_3 req 83-83;
SG_MUL_VAL_ 145 motor_status_4 req 84-84;
SG_MUL_VAL_ 145 motor_status_5 req 85-85;
SG_MUL_VAL_ 145 maintenance_success_0 req 96-96;
SG_MUL_VAL_ 145 maintenance_success_1 req 97-97;
SG_MUL_VAL_ 145 maintenance_success_2 req 98-98;
SG_MUL_VAL_ 145 maintenance_success_3 req 99-99;
SG_MUL_VAL_ 145 maintenance_success_4 req 100-100;
SG_MUL_VAL_ 145 maintenance_success_5 req 101-101;
SG_MUL_VAL_ 144 stepper_spec_req_event_0 cmd 112-112;
SG_MUL_VAL_ 144 stepper_spec_req_event_1 cmd 113-113;
SG_MUL_VAL_ 144 stepper_spec_req_event_2 cmd 114-114;
SG_MUL_VAL_ 144 stepper_spec_req_event_3 cmd 115-115;
SG_MUL_VAL_ 144 stepper_spec_req_event_4 cmd 116-116;
SG_MUL_VAL_ 144 stepper_spec_req_event_5 cmd 117-117;
SG_MUL_VAL_ 145 stepper_velocity_max_0 req 112-112;
SG_MUL_VAL_ 145 step_angle_0 req 112-112;
SG_MUL_VAL_ 145 stepper_velocity_max_1 req 113-112;
SG_MUL_VAL_ 145 step_angle_1 req 113-113;
SG_MUL_VAL_ 145 stepper_velocity_max_2 req 114-114;
SG_MUL_VAL_ 145 step_angle_2 req 114-114;
SG_MUL_VAL_ 145 stepper_velocity_max_3 req 115-115;
SG_MUL_VAL_ 145 step_angle_3 req 115-115;
SG_MUL_VAL_ 145 stepper_velocity_max_4 req 116-116;
SG_MUL_VAL_ 145 step_angle_4 req 116-116;
SG_MUL_VAL_ 145 stepper_velocity_max_5 req 117-117;
SG_MUL_VAL_ 145 step_angle_5 req 117-117;
SG_MUL_VAL_ 129 servo_velocity_max_5 req 117-117;
SG_MUL_VAL_ 129 led_success req 17-17;
