VERSION ""

NS_ :

BS_:

BU_:

BO_ 128 SERVO_PCB_C: 8 Vector__XXX
	SG_ cmd M : 0|8@1+ (1,0) [0|0] "" Vector__XXX
	SG_ status_heartbeat_delay m16M : 8|8@1+ (1,0) [0|255] "sec" Vector__XXX
	SG_ led_status m17M : 8|1@1+ (1,0) [0|1] "bool" Vector__XXX
	SG_ general_0 m18M : 8|8@1+ (1,0) [0|255] "" Vector__XXX
	SG_ general_1 m18M : 16|8@1+ (1,0) [0|255] "" Vector__XXX
	SG_ general_2 m18M : 24|8@1+ (1,0) [0|255] "" Vector__XXX
	SG_ general_3 m18M : 32|8@1+ (1,0) [0|255] "" Vector__XXX
	SG_ general_4 m18M : 40|8@1+ (1,0) [0|255] "" Vector__XXX
	SG_ general_5 m18M : 48|8@1+ (1,0) [0|255] "" Vector__XXX
	SG_ motor_position_target_0 m32M : 8|16@1- (1,0) [-32768|32767] "deg" Vector__XXX
	SG_ motor_position_target_1 m33M : 8|16@1- (1,0) [-32768|32767] "deg" Vector__XXX
	SG_ motor_position_target_2 m34M : 8|16@1- (1,0) [-32768|32767] "deg" Vector__XXX
	SG_ motor_position_target_3 m35M : 8|16@1- (1,0) [-32768|32767] "deg" Vector__XXX
	SG_ motor_position_target_4 m36M : 8|16@1- (1,0) [-32768|32767] "deg" Vector__XXX
	SG_ motor_position_target_5 m37M : 8|16@1- (1,0) [-32768|32767] "deg" Vector__XXX
	SG_ motor_velocity_target_0 m48M : 8|16@1- (1,0) [-32768|32767] "deg/s" Vector__XXX
	SG_ motor_velocity_target_1 m49M : 8|16@1- (1,0) [-32768|32767] "deg/s" Vector__XXX
	SG_ motor_velocity_target_2 m50M : 8|16@1- (1,0) [-32768|32767] "deg/s" Vector__XXX
	SG_ motor_velocity_target_3 m51M : 8|16@1- (1,0) [-32768|32767] "deg/s" Vector__XXX
	SG_ motor_velocity_target_4 m52M : 8|16@1- (1,0) [-32768|32767] "deg/s" Vector__XXX
	SG_ motor_velocity_target_5 m53M : 8|16@1- (1,0) [-32768|32767] "deg/s" Vector__XXX

BO_ 129 SERVO_PCB_R: 8 Vector__XXX
	SG_ req M : 0|8@1+ (1,0) [0|0] "" Vector__XXX
	SG_ status_0 m16M : 8|8@1+ (1,0) [0|255] "" Vector__XXX
	SG_ status_1 m16M : 16|8@1+ (1,0) [0|255] "" Vector__XXX
	SG_ status_2 m16M : 24|8@1+ (1,0) [0|255] "" Vector__XXX
	SG_ status_3 m16M : 32|8@1+ (1,0) [0|255] "" Vector__XXX
	SG_ status_4 m16M : 40|8@1+ (1,0) [0|255] "" Vector__XXX
	SG_ status_5 m16M : 48|8@1+ (1,0) [0|255] "" Vector__XXX
	SG_ motor_position_0 m32M : 8|16@1- (1,0) [-32768|32767] "deg" Vector__XXX
	SG_ motor_velocity_0 m32M : 24|16@1- (1,0) [-32768|32767] "deg/s" Vector__XXX
	SG_ motor_position_1 m33M : 8|16@1- (1,0) [-32768|32767] "deg" Vector__XXX
	SG_ motor_velocity_1 m33M : 24|16@1- (1,0) [-32768|32767] "deg/s" Vector__XXX
	SG_ motor_position_2 m34M : 8|16@1- (1,0) [-32768|32767] "deg" Vector__XXX
	SG_ motor_velocity_2 m34M : 24|16@1- (1,0) [-32768|32767] "deg/s" Vector__XXX
	SG_ motor_position_3 m35M : 8|16@1- (1,0) [-32768|32767] "deg" Vector__XXX
	SG_ motor_velocity_3 m35M : 24|16@1- (1,0) [-32768|32767] "deg/s" Vector__XXX
	SG_ motor_position_4 m36M : 8|16@1- (1,0) [-32768|32767] "deg" Vector__XXX
	SG_ motor_velocity_4 m36M : 24|16@1- (1,0) [-32768|32767] "deg/s" Vector__XXX
	SG_ motor_position_5 m37M : 8|16@1- (1,0) [-32768|32767] "deg" Vector__XXX
	SG_ motor_velocity_5 m37M : 24|16@1- (1,0) [-32768|32767] "deg/s" Vector__XXX
	SG_ servo_type_0 m48M : 8|1@1+ (1,0) [0|1] "bool" Vector__XXX
	SG_ servo_position_max_0 m48M : 16|16@1- (1,0) [-32768|32767] "deg" Vector__XXX
	SG_ servo_velocity_max_0 m48M : 32|16@1- (1,0) [-32768|32767] "deg/s" Vector__XXX
	SG_ servo_type_1 m49M : 8|1@1+ (1,0) [0|1] "bool" Vector__XXX
	SG_ servo_position_max_1 m49M : 16|16@1- (1,0) [-32768|32767] "deg" Vector__XXX
	SG_ servo_velocity_max_1 m49M : 32|16@1- (1,0) [-32768|32767] "deg/s" Vector__XXX
	SG_ servo_type_2 m50M : 8|1@1+ (1,0) [0|1] "bool" Vector__XXX
	SG_ servo_position_max_2 m50M : 16|16@1- (1,0) [-32768|32767] "deg" Vector__XXX
	SG_ servo_velocity_max_2 m50M : 32|16@1- (1,0) [-32768|32767] "deg/s" Vector__XXX
	SG_ servo_type_3 m51M : 8|1@1+ (1,0) [0|1] "bool" Vector__XXX
	SG_ servo_position_max_3 m51M : 16|16@1- (1,0) [-32768|32767] "deg" Vector__XXX
	SG_ servo_velocity_max_3 m51M : 32|16@1- (1,0) [-32768|32767] "deg/s" Vector__XXX
	SG_ servo_type_4 m52M : 8|1@1+ (1,0) [0|1] "bool" Vector__XXX
	SG_ servo_position_max_4 m52M : 16|16@1- (1,0) [-32768|32767] "deg" Vector__XXX
	SG_ servo_velocity_max_4 m52M : 32|16@1- (1,0) [-32768|32767] "deg/s" Vector__XXX
	SG_ servo_type_5 m53M : 8|1@1+ (1,0) [0|1] "bool" Vector__XXX
	SG_ servo_position_max_5 m53M : 16|16@1- (1,0) [-32768|32767] "deg" Vector__XXX
	SG_ servo_velocity_max_5 m53M : 32|16@1- (1,0) [-32768|32767] "deg/s" Vector__XXX

CM_ SG_ 128 cmd "This is used to mux the remaining bytes of 0x080 messages.";
CM_ SG_ 128 status_heartbeat_delay "If status_heartbeat_delay = 1-255 | PCB will send status heartbeats every that many seconds. If status_heartbeat_delay = 0 |  PCB will send no heartbeats.";
CM_ SG_ 128 led_status "If led_status = false | The onboard PCB LED will be turned off. If led_status = true | The onboard PCB LED will be turned on.";
CM_ SG_ 128 general_0 "0: Set current multi-turn position to ROM as zero 1: Request servo vectors (position, velocity), 2: Stop Motor, 3: Clear Error";
CM_ SG_ 128 general_1 "general command byte for servo 1 when cmd=0x12.";
CM_ SG_ 128 general_2 "general command byte for servo 2 when cmd=0x12.";
CM_ SG_ 128 general_3 "general command byte for servo 3 when cmd=0x12.";
CM_ SG_ 128 general_4 "general command byte for servo 4 when cmd=0x12.";
CM_ SG_ 128 general_5 "general command byte for servo 5 when cmd=0x12.";
CM_ SG_ 128 motor_position_target_0 "Set the absolute position of the servo in integer units degrees. Note: Some servos have built turn limits while others allow continuous movement. Uses typical turn sign convention: counter-clockwise (+) and clockwise (-).";
CM_ SG_ 128 motor_velocity_target_0 "Set the relative velocity of the servo in integer units degrees per second. Note: This option will not work for servos that do not have continuous turn mode. Uses typical turn sign convention: counter-clockwise (+) and clockwise (-).";

CM_ SG_ 129 status_0 "0: Undefined | 1: Idle | 2: Startup Sequence | 3: Error | 4: Error (Invalid Request) 5: Error (Motor Disarmed) | 6: Error (Motor Failed) | 7: Error (Controller Failed) 8: Error (ESTOP Requested) | 9: Error (Unknown Position) | 10: Position Control 11: Vel";
CM_ SG_ 129 status_1 "status byte for servo 1 when req=0x10.";
CM_ SG_ 129 status_2 "status byte for servo 2 when req=0x10.";
CM_ SG_ 129 status_3 "status byte for servo 3 when req=0x10.";
CM_ SG_ 129 status_4 "status byte for servo 4 when req=0x10.";
CM_ SG_ 129 status_5 "status byte for servo 5 when req=0x10.";
CM_ SG_ 129 motor_position_0 "The absolute position of the servo in integer units degrees. Uses typical turn sign convention: counter-clockwise (+) and clockwise (-).";
CM_ SG_ 129 motor_velocity_0 "The relative velocity of the servo in integer units degrees per second. Uses typical turn sign convention: counter-clockwise (+) and clockwise (-).";
CM_ SG_ 129 servo_type_0 "servo_type = false | The servo is standard servo_type = true | The servo is continuous";
CM_ SG_ 129 servo_position_max_0 "The max position span the servo is capable of.";
CM_ SG_ 129 servo_velocity_max_0 "The max speed the servo is capable of.";

BA_DEF_ BO_  "VFrameFormat" ENUM  "StandardCAN","ExtendedCAN","reserved","J1939PG";
BA_DEF_  "DatabaseVersion" STRING ;
BA_DEF_  "BusType" STRING ;
BA_DEF_  "ProtocolType" STRING ;
BA_DEF_  "DatabaseCompiler" STRING ;
BA_DEF_DEF_  "VFrameFormat" "J1939PG";
BA_DEF_DEF_  "DatabaseVersion" "DEMO PLUS";
BA_DEF_DEF_  "BusType" "";
BA_DEF_DEF_  "ProtocolType" "";
BA_DEF_DEF_  "DatabaseCompiler" "";
BA_ "ProtocolType" "J1939";
BA_ "BusType" "CAN";
BA_ "DatabaseCompiler" "CSS ELECTRONICS (WWW.CSSELECTRONICS.COM)";
BA_ "DatabaseVersion" "1.0.0";

; ===== Multiplexing maps =====

; 0x080 (128) command mux
SG_MUL_VAL_ 128 status_heartbeat_delay cmd 16-16;
SG_MUL_VAL_ 128 led_status cmd 17-17;

; bulk general (cmd = 18 / 0x12)
SG_MUL_VAL_ 128 general_0 cmd 18-18;
SG_MUL_VAL_ 128 general_1 cmd 18-18;
SG_MUL_VAL_ 128 general_2 cmd 18-18;
SG_MUL_VAL_ 128 general_3 cmd 18-18;
SG_MUL_VAL_ 128 general_4 cmd 18-18;
SG_MUL_VAL_ 128 general_5 cmd 18-18;

; position targets: cmd = 32..37 (0x20..0x25)
SG_MUL_VAL_ 128 motor_position_target_0 cmd 32-32;
SG_MUL_VAL_ 128 motor_position_target_1 cmd 33-33;
SG_MUL_VAL_ 128 motor_position_target_2 cmd 34-34;
SG_MUL_VAL_ 128 motor_position_target_3 cmd 35-35;
SG_MUL_VAL_ 128 motor_position_target_4 cmd 36-36;
SG_MUL_VAL_ 128 motor_position_target_5 cmd 37-37;

; velocity targets: cmd = 48..53 (0x30..0x35)
SG_MUL_VAL_ 128 motor_velocity_target_0 cmd 48-48;
SG_MUL_VAL_ 128 motor_velocity_target_1 cmd 49-49;
SG_MUL_VAL_ 128 motor_velocity_target_2 cmd 50-50;
SG_MUL_VAL_ 128 motor_velocity_target_3 cmd 51-51;
SG_MUL_VAL_ 128 motor_velocity_target_4 cmd 52-52;
SG_MUL_VAL_ 128 motor_velocity_target_5 cmd 53-53;

; 0x081 (129) response mux
SG_MUL_VAL_ 129 status_0 req 16-16;

; bulk status (req = 18 / 0x12) — note status_0 stays on req=0x10 in this DBC
SG_MUL_VAL_ 129 status_1 req 16-16;
SG_MUL_VAL_ 129 status_2 req 16-16;
SG_MUL_VAL_ 129 status_3 req 16-16;
SG_MUL_VAL_ 129 status_4 req 16-16;
SG_MUL_VAL_ 129 status_5 req 16-16;

; vectors: req = 32..37 (0x20..0x25)
SG_MUL_VAL_ 129 motor_position_0 req 32-32;
SG_MUL_VAL_ 129 motor_velocity_0 req 32-32;
SG_MUL_VAL_ 129 motor_position_1 req 33-33;
SG_MUL_VAL_ 129 motor_velocity_1 req 33-33;
SG_MUL_VAL_ 129 motor_position_2 req 34-34;
SG_MUL_VAL_ 129 motor_velocity_2 req 34-34;
SG_MUL_VAL_ 129 motor_position_3 req 35-35;
SG_MUL_VAL_ 129 motor_velocity_3 req 35-35;
SG_MUL_VAL_ 129 motor_position_4 req 36-36;
SG_MUL_VAL_ 129 motor_velocity_4 req 36-36;
SG_MUL_VAL_ 129 motor_position_5 req 37-37;
SG_MUL_VAL_ 129 motor_velocity_5 req 37-37;

; servo info: req = 48..53 (0x30..0x35)
SG_MUL_VAL_ 129 servo_type_0 req 48-48;
SG_MUL_VAL_ 129 servo_position_max_0 req 48-48;
SG_MUL_VAL_ 129 servo_velocity_max_0 req 48-48;
SG_MUL_VAL_ 129 servo_type_1 req 49-49;
SG_MUL_VAL_ 129 servo_position_max_1 req 49-49;
SG_MUL_VAL_ 129 servo_velocity_max_1 req 49-49;
SG_MUL_VAL_ 129 servo_type_2 req 50-50;
SG_MUL_VAL_ 129 servo_position_max_2 req 50-50;
SG_MUL_VAL_ 129 servo_velocity_max_2 req 50-50;
SG_MUL_VAL_ 129 servo_type_3 req 51-51;
SG_MUL_VAL_ 129 servo_position_max_3 req 51-51;
SG_MUL_VAL_ 129 servo_velocity_max_3 req 51-51;
SG_MUL_VAL_ 129 servo_type_4 req 52-52;
SG_MUL_VAL_ 129 servo_position_max_4 req 52-52;
SG_MUL_VAL_ 129 servo_velocity_max_4 req 52-52;
SG_MUL_VAL_ 129 servo_type_5 req 53-53;
SG_MUL_VAL_ 129 servo_position_max_5 req 53-53;
SG_MUL_VAL_ 129 servo_velocity_max_5 req 53-53;
